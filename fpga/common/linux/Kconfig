## fpga/common/linux/Kconfig
```kconfig
config RAPTOR_ETH
	tristate "Raptor Ethernet controller"
	depends on OF && HAS_IOMEM && NETDEVICES && ETHERNET
	select PHYLIB
	select MDIO_BITBANG
	help
	  Raptor Ethernet controller supporting eight-slot 32-bit packet SRAM
	  programmed I/O (ABI v1) and 64-bit AXI4 Ring DMA (ABI v2).
	  Select built-in when using an NFS root filesystem.
```
