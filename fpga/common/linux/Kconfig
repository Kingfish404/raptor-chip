## fpga/common/linux/Kconfig
```kconfig
config RAPTOR_NATIVE_ETH
	tristate "Raptor native packet SRAM Ethernet"
	depends on OF && HAS_IOMEM && NETDEVICES && ETHERNET
	select PHYLIB
	select MDIO_BITBANG
	help
	  Native RK-XCKU5P-F Ethernet with eight receive slots and one transmit
	  buffer. Uses aligned 32-bit programmed I/O, with no DMA into main RAM.
	  Select built-in when using an NFS root filesystem.
```

## nemu/configs/riscv64-am_defconfig
```kconfig
CONFIG_RV64=y
CONFIG_RV_F=y
CONFIG_RV_D=y
CONFIG_RV_SVADE=y
CONFIG_TARGET_AM=y
CONFIG_DEBUG=y
CONFIG_RV_EBREAK_HOST_EXIT=y
# CONFIG_TRACE is not set
CONFIG_MSIZE=0x2000000
CONFIG_DEVICE=y
```

## nemu/configs/riscv64_sampling_defconfig
```kconfig
# Deterministic single-hart CPU/RAM sampling; no network, disk or RNG device.
CONFIG_ISA_riscv=y
CONFIG_RV64=y
CONFIG_RV_F=y
CONFIG_RV_D=y
CONFIG_RV_SVADE=y
CONFIG_RV_ASID_BITS=9
CONFIG_RV_PMPADDR_BITS=30
CONFIG_RV_PC_BITS=40
CONFIG_RV_PMP_GRANULARITY_LOG2=12
# CONFIG_RV_MCOUNTINHIBIT is not set
CONFIG_TARGET_NATIVE_ELF=y
# CONFIG_DEBUG is not set
# CONFIG_TRACE is not set
# CONFIG_DIFFTEST is not set
CONFIG_ROM=y
CONFIG_ROM_DTB=y
CONFIG_ROM_DTB_PATH="./src/memory/rom/spike-rv64gc-nemu.dtb"
CONFIG_MBASE=0x80000000
CONFIG_MSIZE=0x80000000
CONFIG_PMEM_MALLOC=y
CONFIG_RAPTOR_PMEM_2G=y
CONFIG_DEVICE=y
CONFIG_HAS_SERIAL=y
CONFIG_SERIAL_INPUT_FIFO=y
CONFIG_SERIAL_MMIO=0x000003f8
CONFIG_SERIAL_MMIO_US16550=0x10000000
CONFIG_SERIAL_PLIC_IRQ=10
CONFIG_HAS_TIMER=y
CONFIG_RTC_MMIO=0x00000048
CONFIG_RTC_MMIO_CLINT=0x02000000
CONFIG_PLIC_MMIO=0x0c000000
CONFIG_HAS_FINISHER=y
CONFIG_FINISHER_MMIO=0x00100000
# CONFIG_HAS_KEYBOARD is not set
# CONFIG_HAS_VGA is not set
# CONFIG_HAS_AUDIO is not set
# CONFIG_HAS_DISK is not set
# CONFIG_HAS_NET is not set
# CONFIG_HAS_RNG is not set
# CONFIG_HAS_SDCARD is not set
CONFIG_TIMER_CYCLE=y
CONFIG_RT_CHECK=y
CONFIG_RAPTOR_MEMORY_MAP=y
```

## nemu/configs/riscv64gc_linux_defconfig
```kconfig
CONFIG_ISA_riscv=y
CONFIG_RV64=y
CONFIG_RV_F=y
CONFIG_RV_D=y
CONFIG_RV_SVADE=y
CONFIG_TARGET_NATIVE_ELF=y
# CONFIG_DEBUG is not set
# CONFIG_TRACE is not set
# CONFIG_DIFFTEST is not set
CONFIG_ROM=y
CONFIG_ROM_DTB=y
CONFIG_ROM_DTB_PATH="./src/memory/rom/spike-rv64gc-nemu.dtb"
CONFIG_MBASE=0x80000000
CONFIG_MSIZE=0x10000000
CONFIG_PMEM_GARRAY=y
CONFIG_DEVICE=y
CONFIG_HAS_SERIAL=y
CONFIG_SERIAL_INPUT_FIFO=y
CONFIG_SERIAL_MMIO=0x000003f8
CONFIG_SERIAL_MMIO_US16550=0x10000000
CONFIG_HAS_TIMER=y
CONFIG_RTC_MMIO=0x00000048
CONFIG_RTC_MMIO_CLINT=0x02000000
CONFIG_PLIC_MMIO=0x0c000000
CONFIG_HAS_FINISHER=y
CONFIG_FINISHER_MMIO=0x00100000
# CONFIG_HAS_KEYBOARD is not set
# CONFIG_HAS_VGA is not set
# CONFIG_HAS_AUDIO is not set
# CONFIG_HAS_DISK is not set
CONFIG_HAS_NET=y
CONFIG_NET_MMIO=0x10002000
CONFIG_NET_PLIC_IRQ=2
CONFIG_HAS_RNG=y
CONFIG_RNG_MMIO=0x10003000
CONFIG_RNG_PLIC_IRQ=3
# CONFIG_HAS_SDCARD is not set
CONFIG_TIMER_CYCLE=y
CONFIG_RT_CHECK=y
```

## nemu/src/device/Kconfig
```kconfig
menuconfig DEVICE
  depends on !TARGET_SHARE
  bool "Devices"
  default y
  help
    Provide device support for NEMU.

if DEVICE

config HAS_PORT_IO
  bool
  default y if ISA_x86
  default n

config DTRACE
  bool "Enable device tracer"
  default n

menuconfig HAS_SERIAL
  bool "Enable serial"
  default y

if HAS_SERIAL
config SERIAL_PORT
  depends on HAS_PORT_IO
  hex "Port address of the serial controller"
  default 0x3f8

config SERIAL_MMIO
  hex "MMIO address of the serial controller"
  default 0x000003f8

config SERIAL_INPUT_FIFO
  bool "Enable input FIFO with /tmp/nemu.serial"
  default n

config SERIAL_MMIO_US16550
  hex "MMIO address of the serial controller (US16550)"
  default 0x10000000

config SERIAL_PLIC_IRQ
  int "PLIC interrupt source ID for the ns16550 UART"
  default 1
  help
    PLIC source ID raised by the ns16550 model. Must match the
    `interrupts = <N>` cell in the bundled DTB used by the guest
    (see nemu/src/memory/rom/spike-rv*ima*.dts). Linux derives the
    handler from the DTB, so a mismatch silently drops UART RX IRQs.
    Bare-metal/tinyos workloads that poll LSR.DR are unaffected, but
    avoid colliding with VIRTIO_BLK_PLIC_IRQ.

endif # HAS_SERIAL

menuconfig HAS_TIMER
  bool "Enable timer"
  default y

if HAS_TIMER
config RTC_PORT
  depends on HAS_PORT_IO
  hex "Port address of the timer"
  default 0x48

config RTC_MMIO
  hex "MMIO address of the timer"
  default 0x00000048

config RTC_MMIO_CLINT
  hex "MMIO address of the timer (CLINT)"
  default 0x02000000
endif # HAS_TIMER


config PLIC_MMIO
  hex "MMIO address of the PLIC"
  default 0x0c000000

menuconfig HAS_FINISHER
  bool "Enable finisher (sifive,test / syscon-poweroff)"
  default y

if HAS_FINISHER
config FINISHER_MMIO
  hex "MMIO address of the finisher"
  default 0x00100000
endif # HAS_FINISHER

menuconfig HAS_KEYBOARD
  bool "Enable keyboard"
  default y

if HAS_KEYBOARD
config I8042_DATA_PORT
  depends on HAS_PORT_IO
  hex "Port address of the keyboard controller"
  default 0x60

config I8042_DATA_MMIO
  hex "MMIO address of the keyboard controller"
  default 0x00000060
endif # HAS_KEYBOARD

menuconfig HAS_VGA
  bool "Enable VGA"
  default y

if HAS_VGA
config FB_ADDR__
  hex "Physical address of the VGA frame buffer"
  default 0x01000000

config VGA_CTL_PORT
  depends on HAS_PORT_IO
  hex "Port address of the VGA controller"
  default 0x100

config VGA_CTL_MMIO
  hex "MMIO address of the VGA controller"
  default 0x00000100

config VGA_SHOW_SCREEN
  bool "Enable SDL SCREEN"
  default y

choice
  prompt "Screen Size"
  default VGA_SIZE_400x300
config VGA_SIZE_400x300
  bool "400 x 300"
config VGA_SIZE_800x600
  bool "800 x 600"
endchoice
endif # HAS_VGA

if !TARGET_AM
menuconfig HAS_AUDIO
  bool "Enable audio"
  default y

if HAS_AUDIO
config SB_ADDR
  hex "Physical address of the audio stream buffer"
  default 0x01200000

config SB_SIZE
  hex "Size of the audio stream buffer"
  default 0x10000

config AUDIO_CTL_PORT
  depends on HAS_PORT_IO
  hex "Port address of the audio controller"
  default 0x200

config AUDIO_CTL_MMIO
  hex "MMIO address of the audio controller"
  default 0x00000200
endif # HAS_AUDIO

menuconfig HAS_DISK
  bool "Enable disk"
  default y

if HAS_DISK
config DISK_CTL_PORT
  depends on HAS_PORT_IO
  hex "Port address of the disk controller"
  default 0x300

config DISK_CTL_MMIO
  hex "MMIO address of the disk controller"
  default 0x00000300

config DISK_IMG_PATH
  string "The path of disk image"
  default ""
endif # HAS_DISK

menuconfig HAS_NET
  bool "Enable virtio network with user-mode NAT"
  depends on !TARGET_AM
  default n
  help
    Provide a virtio-mmio network adapter backed by libslirp. The guest gets
    an address from the built-in DHCP server and can reach the host network
    without root privileges, a TAP device, or host-side bridge setup.

if HAS_NET
config NET_MMIO
  hex "MMIO address of the virtio network adapter"
  default 0x10002000

config NET_PLIC_IRQ
  int "PLIC interrupt source ID for the virtio network adapter"
  default 2
  help
    Must match the interrupts cell of the virtio,mmio node in the guest DTB.
endif # HAS_NET

menuconfig HAS_RNG
  bool "Enable virtio random number generator"
  depends on !TARGET_AM
  default n
  help
    Provide a virtio-mmio entropy device backed by the host operating
    system's cryptographically secure random number generator.

if HAS_RNG
config RNG_MMIO
  hex "MMIO address of the virtio random number generator"
  default 0x10003000

config RNG_PLIC_IRQ
  int "PLIC interrupt source ID for the virtio random number generator"
  default 3
  help
    Must match the interrupts cell of the virtio,mmio RNG node in the guest
    DTB and must not collide with another emulated device.
endif # HAS_RNG

menuconfig HAS_SDCARD
  bool "Enable sdcard"
  default n

if HAS_SDCARD
config SDCARD_CTL_MMIO
  hex "MMIO address of the sdcard controller"
  default 0x03000000

config SDCARD_IMG_PATH
  string "The path of sdcard image"
  default ""
endif # HAS_SDCARD
endif

endif # DEVICE
```

## nemu/src/isa/riscv/Kconfig
```kconfig
menu "ISA-dependent Options for riscv"

config RV64
  bool "64-bit RISC-V architecture"
  default n

config RV_ASID_BITS
  int "Implemented RV64 satp ASID bits"
  depends on RV64
  range 0 16
  default 16
  help
    Generic RV64 platforms implement all 16 ASID bits, matching Sail.
    Set to 9 for the Raptor reference model. Unimplemented high ASID
    bits read as zero; MODE and PPN retain their existing WARL behavior.

config RV_PMPADDR_BITS
  int "Implemented RV64 pmpaddr bits"
  depends on RV64
  range 1 54
  default 54
  help
    pmpaddr holds physical-address bits [N+1:2]. The architectural maximum
    for RV64 is 54 (56-bit physical addresses). Set to 30 for the Raptor
    reference model, whose RTL implements 32 physical-address bits
    (RAPT_PADDR_BITS). Configurable Raptor references use 30..36
    for PA 32..38. Unimplemented high bits read as zero.

config RV_PC_BITS
  int "Implemented RV64 PC bits"
  depends on RV64
  range 40 64
  default 64
  help
    Width of the implemented PC representation. With 40, a jump, xRET or
    trap-vector target whose bits [63:39] are not all equal is replaced by
    another invalid address before it becomes the PC: bits [37:0] are kept,
    bit 38 becomes the inverse of bit 63 and bits [63:39] copy bit 63. This
    matches Raptor RTL with RAPT_PADDR_BITS <= 39 (the privileged spec lets
    xepc/xtval hold a converted invalid address). Keep 64 for other targets.

config RV_PMP_GRANULARITY_LOG2
  int "PMP minimum region size (log2 bytes)"
  range 2 12
  default 12
  help
    Raptor implements 4 KiB PMP regions (12, architectural G=10).
    NA4 is unavailable above 2. OFF/TOR addresses read with G low
    bits cleared; NAPOT addresses read with G-1 low bits set, while
    retaining the underlying stored address across mode changes.
    Set to 2 for comparison with the legacy 4-byte-grain platform.

config RVE
  bool "Use E extension"
  default n

config RV_F
  bool "F: single-precision floating-point extension"
  default y if RV64
  default n

config RV_D
  bool "D: double-precision floating-point extension"
  depends on RV_F
  default y if RV64
  default n

config RV_SVADE
  bool "Svade: A/D bits faulted by hardware (instead of Svadu auto-update)"
  default y
  help
    Match the Raptor HDL page-table walker: an access with PTE.A=0, or a
    store with PTE.D=0, raises a page fault and never updates the PTE in
    hardware. Disable only when intentionally modeling a Svadu target.

config RV_RVA22S64
  bool "RVA22S64 architectural execution environment"
  depends on RV64 && RV_F && RV_D && RV_SVADE
  default y
  help
    Enable the RVA22S64 execution environment by default for RV64, matching
    the default RV64 RTL configuration.

config RV_MCOUNTINHIBIT
  bool "Optional mcountinhibit CSR (read-only zero)"
  default y if RV_RVA22S64
  default n
  help
    Expose the optional mcountinhibit CSR as read-only zero so firmware
    such as OpenSBI can discover privileged architecture 1.12 through
    mcounteren, mcountinhibit and menvcfg. Counters always run.
    Disable when using NEMU as a reference for a core without this CSR,
    including the current Raptor RTL. This is independent of RVA22S64.

config RV_EBREAK_HOST_EXIT
  bool "Legacy EBREAK host-exit convention"
  depends on DEBUG
  default y if !RV64
  default n
  help
    Treat EBREAK (including C.EBREAK) as a host test exit using a0,
    except while signature testing. Enable for legacy AM/test payloads
    that use this convention. Otherwise EBREAK raises a guest breakpoint
    exception, including in debug builds. Independent of ISA support.
endmenu
```
