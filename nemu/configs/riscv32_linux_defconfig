## nemu/src/memory/Kconfig
```kconfig
menu "Memory Configuration"

config ROM
  bool "Enable ROM"
  default y
  help
    Enable ROM for the system. This is used for storing the bootloader
    and other system firmware.

config ROM_DTB
  bool "Enable ROM DTB"
  depends on !TARGET_AM
  depends on ROM
  default n
  help
    Enable ROM DTB for the system. This is used for storing the device
    tree blob.

config ROM_DTB_PATH
  string "Path to ROM DTB"
  depends on ROM_DTB
  default "./src/memory/rom/spike-rv32ima.dtb"
  help
    Specify the path to the device tree blob file.

config MBASE
  hex "Memory base address"
  default 0x0        if ISA_x86
  default 0x80000000

config MSIZE
  hex "Memory size"
  default 0x8000000

config PC_RESET_OFFSET
  hex "Offset of reset vector from the base of memory"
  default 0x100000 if ISA_x86
  default 0

config MTRACE
  bool "Enable memory tracer"
  default n

choice
  prompt "Physical memory definition"
  default PMEM_GARRAY
config PMEM_MALLOC
  bool "Using malloc()"
config PMEM_GARRAY
  depends on !TARGET_AM
  bool "Using global array"
endchoice

config MEM_RANDOM
  depends on MODE_SYSTEM && !DIFFTEST && !TARGET_AM
  bool "Initialize the memory with random values"
  default n
  help
    This may help to find undefined behaviors.

endmenu #MEMORY
```

## npc/Kconfig
```kconfig
mainmenu "NPC Configuration Menu"

choice
  prompt "Optimization Level"
  default CC_O2
config CC_O0
  bool "O0"
config CC_O1
  bool "O1"
config CC_O2
  bool "O2"
config CC_O3
  bool "O3"
endchoice

config CC_OPT
  string
  default "-O0" if CC_O0
  default "-O1" if CC_O1
  default "-O2" if CC_O2
  default "-O3" if CC_O3
  default "none"

menu "Testing and Debugging"

config WTRACE
  bool "Enable wave tracer"
  default n

config ITRACE
  bool "Enable instruction tracer"
  default y

config DIFFTEST
    bool "Enable differential testing"
    default y
    help
      Enable differential testing with a reference design.
      Note that this will significantly reduce the performance of NPC.

config MEM_DIFFTEST
    bool "Enable memory differential testing"
    default n
    depends on DIFFTEST
    help
      Enable memory differential testing with a reference design.
      Note that this will significantly reduce the performance of NPC.

endmenu
```
